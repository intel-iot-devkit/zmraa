## prj.conf
```kconfig
CONFIG_STDOUT_CONSOLE=y
CONFIG_CONSOLE_HANDLER=y
CONFIG_CONSOLE_HANDLER_SHELL=y
CONFIG_I2C=y
CONFIG_GPIO=y

CONFIG_MRAA=y
CONFIG_MRAA_I2C=y
CONFIG_MRAA_GPIO=y

# malloc/free
CONFIG_NEWLIB_LIBC=y
```

## src/main.c
```c
/*
 * Author: Henry Bruce <henry.bruce@intel.com>
 * Copyright (c) 2016 Intel Corporation.
 *
 * Permission is hereby granted, free of charge, to any person obtaining
 * a copy of this software and associated documentation files (the
 * "Software"), to deal in the Software without restriction, including
 * without limitation the rights to use, copy, modify, merge, publish,
 * distribute, sublicense, and/or sell copies of the Software, and to
 * permit persons to whom the Software is furnished to do so, subject to
 * the following conditions:
 *
 * The above copyright notice and this permission notice shall be
 * included in all copies or substantial portions of the Software.
 *
 * THE SOFTWARE IS PROVIDED "AS IS", WITHOUT WARRANTY OF ANY KIND,
 * EXPRESS OR IMPLIED, INCLUDING BUT NOT LIMITED TO THE WARRANTIES OF
 * MERCHANTABILITY, FITNESS FOR A PARTICULAR PURPOSE AND
 * NONINFRINGEMENT. IN NO EVENT SHALL THE AUTHORS OR COPYRIGHT HOLDERS BE
 * LIABLE FOR ANY CLAIM, DAMAGES OR OTHER LIABILITY, WHETHER IN AN ACTION
 * OF CONTRACT, TORT OR OTHERWISE, ARISING FROM, OUT OF OR IN CONNECTION
 * WITH THE SOFTWARE OR THE USE OR OTHER DEALINGS IN THE SOFTWARE.
 */

#include <stdio.h>
#include <stdlib.h>
#include <string.h>
#include <shell/shell.h>
#include "gpio-cmd.h"
#include "i2c-cmd.h"
#include "mraa/common.h"

#define MRAA_SHELL_MODULE "mraa"

static int shell_cmd_version(int argc, char* argv[])
{
    printf("ZMRAA %s on %s\n", mraa_get_version(), mraa_get_platform_name());
    return 0;
}

static int shell_cmd_gpio(int argc, char* argv[])
{
    argc--;
    for (int i = 0; i < argc; ++i)
        argv[i] = argv[i+1];
    if (argc > 0)
    {
        if (strcmp(argv[0], "help") == 0)
            gpio_cmd_help(argc, argv);
        else if (strcmp(argv[0], "list") == 0)
            gpio_cmd_list(argc, argv);
        else if (strcmp(argv[0], "get") == 0)
            gpio_cmd_get(argc, argv);
        else if (strcmp(argv[0], "set") == 0)
            gpio_cmd_set(argc, argv);
        else if (strcmp(argv[0], "monitor") == 0)
            gpio_cmd_monitor(argc, argv);
        else
        {
            printf("Unknown gpio command.\n");
            gpio_cmd_help(argc, argv);
        }
    }
    else
        printf("Must specify gpio command. \n");
    return 0;
}

static int shell_cmd_i2c(int argc, char* argv[])
{
    i2c_process_command(argc, argv);
    return 0;
}

const struct shell_cmd commands[] = {
    {"version", shell_cmd_version, NULL},
    {"gpio", shell_cmd_gpio, NULL},
    {"i2c", shell_cmd_i2c, NULL},
    {NULL, NULL, NULL}};

void main(void)
{
    /* Initialize mraa */
    mraa_result_t status = mraa_init();
    if (status != MRAA_SUCCESS)
    {
        printf("mraa_init() failed with error code %d\n", status);
        return;
    }

    /* Register this module w/commands */
    SHELL_REGISTER(MRAA_SHELL_MODULE, commands);

    /* Print the current shell version */
    shell_cmd_version(0, NULL);

    /* Set the default shell module and initialize */
    shell_register_default_module(MRAA_SHELL_MODULE);
}
```

## src/gpio-cmd.c
```c
/*
 * Author: Henry Bruce <henry.bruce@intel.com>
 * Copyright (c) 2016 Intel Corporation.
 *
 * Permission is hereby granted, free of charge, to any person obtaining
 * a copy of this software and associated documentation files (the
 * "Software"), to deal in the Software without restriction, including
 * without limitation the rights to use, copy, modify, merge, publish,
 * distribute, sublicense, and/or sell copies of the Software, and to
 * permit persons to whom the Software is furnished to do so, subject to
 * the following conditions:
 *
 * The above copyright notice and this permission notice shall be
 * included in all copies or substantial portions of the Software.
 *
 * THE SOFTWARE IS PROVIDED "AS IS", WITHOUT WARRANTY OF ANY KIND,
 * EXPRESS OR IMPLIED, INCLUDING BUT NOT LIMITED TO THE WARRANTIES OF
 * MERCHANTABILITY, FITNESS FOR A PARTICULAR PURPOSE AND
 * NONINFRINGEMENT. IN NO EVENT SHALL THE AUTHORS OR COPYRIGHT HOLDERS BE
 * LIABLE FOR ANY CLAIM, DAMAGES OR OTHER LIABILITY, WHETHER IN AN ACTION
 * OF CONTRACT, TORT OR OTHERWISE, ARISING FROM, OUT OF OR IN CONNECTION
 * WITH THE SOFTWARE OR THE USE OR OTHER DEALINGS IN THE SOFTWARE.
 */

#include <stdio.h>
#include <stdlib.h>
#include <string.h>
#include "mraa/gpio.h"


static void
print_help()
{
    printf("list              List pins\n");
    printf("set pin level     Set pin to level (0/1)\n");
    printf("get pin           Get pin level\n");
    printf("monitor pin [off] Monitor pin level changes\n");
    printf("version           Get mraa version and board name\n");
}

static int
list_platform_pins(uint8_t platform_offset)
{
    int pin_count = mraa_get_platform_pin_count(platform_offset);
    int i;
    for (i = 0; i < pin_count; ++i) {
        int pin_id = platform_offset > 0 ? mraa_get_sub_platform_id(i) : i;
        char* pin_name = mraa_get_pin_name(pin_id);
        if (strcmp(pin_name, "INVALID") != 0) {
            printf("%02d ", pin_id);
            printf("%*s: ", (MRAA_PIN_NAME_SIZE - 1), pin_name);
            if (mraa_pin_mode_test(pin_id, MRAA_PIN_GPIO))
                printf("GPIO ");
            if (mraa_pin_mode_test(pin_id, MRAA_PIN_I2C))
                printf("I2C  ");
            if (mraa_pin_mode_test(pin_id, MRAA_PIN_SPI))
                printf("SPI  ");
            if (mraa_pin_mode_test(pin_id, MRAA_PIN_PWM))
                printf("PWM  ");
            if (mraa_pin_mode_test(pin_id, MRAA_PIN_AIO))
                printf("AIO  ");
            if (mraa_pin_mode_test(pin_id, MRAA_PIN_UART))
                printf("UART ");
            printf("\n");
        }
    }
    return pin_count;
}

static int
list_pins()
{
    int pin_count = 0;
    pin_count += list_platform_pins(MRAA_MAIN_PLATFORM_OFFSET);
    if (pin_count == 0) {
        printf("No Pins\n");
    }
    return pin_count;
}

static mraa_result_t
gpio_set(int pin, int level)
{
    mraa_gpio_context gpio = mraa_gpio_init(pin);
    if (gpio != NULL) {
        mraa_gpio_dir(gpio, MRAA_GPIO_OUT);
        mraa_gpio_write(gpio, level);
        return MRAA_SUCCESS;
    }
    return MRAA_ERROR_INVALID_RESOURCE;
}

static mraa_result_t
gpio_get(int pin, int* level)
{
    mraa_gpio_context gpio = mraa_gpio_init(pin);
    if (gpio != NULL) {
        mraa_gpio_dir(gpio, MRAA_GPIO_IN);
        *level = mraa_gpio_read(gpio);
        return MRAA_SUCCESS;
    }
    return MRAA_ERROR_INVALID_RESOURCE;
}

static void
gpio_isr_handler(void* args)
{
    mraa_gpio_context dev = (mraa_gpio_context)args;
    int level = mraa_gpio_read(dev);
    printf("Pin %d = %d\n", mraa_gpio_get_pin_raw(dev), level);
}

static mraa_result_t
gpio_isr_start(int pin)
{
    mraa_gpio_context dev = mraa_gpio_init(pin);
    if (dev != NULL) {
        mraa_result_t status = mraa_gpio_dir(dev, MRAA_GPIO_IN);
        if (status == MRAA_SUCCESS) {
            status = mraa_gpio_isr(dev, MRAA_GPIO_EDGE_BOTH, &gpio_isr_handler, dev);
        }
        return status;
    } else {
        return MRAA_ERROR_INVALID_RESOURCE;
    }
}

static mraa_result_t
gpio_isr_stop(int pin)
{
    mraa_gpio_context dev = mraa_gpio_init(pin);
    if (dev != NULL) {
        mraa_gpio_isr_exit(dev);
        mraa_gpio_close(dev);
    }
    return MRAA_SUCCESS;
}

void
gpio_cmd_help(int argc, char* argv[])
{
    print_help();
}

void
gpio_cmd_list(int argc, char* argv[])
{
    list_pins();
}

void
gpio_cmd_set(int argc, char* argv[])
{
    if (argc == 3) {
        int pin = atoi(argv[1]);
        if (gpio_set(pin, atoi(argv[2])) != MRAA_SUCCESS)
            printf("Could not set gpio %d\n", pin);
    } else {
        printf("Invalid command\n");
    }
}

void
gpio_cmd_get(int argc, char* argv[])
{
    if (argc == 2) {
        int pin = atoi(argv[1]);
        int level;
        if (gpio_get(pin, &level) == MRAA_SUCCESS) {
            printf("Pin %d = %d\n", pin, level);
        } else {
            printf("Could not read gpio %d\n", pin);
        }
    } else {
        printf("Invalid command\n");
    }
}

void
gpio_cmd_monitor(int argc, char* argv[])
{
    if (argc == 2) {
        int pin = atoi(argv[1]);
        if (gpio_isr_start(pin) == MRAA_SUCCESS) {
            printf("Monitoring level changes to pin %d\n", pin);
            // gpio_isr_handler(mraa_gpio_init(pin));
        } else {
            printf("Failed to register ISR for pin %d\n", pin);
        }
    } else if (argc == 3) {
        int pin = atoi(argv[1]);
        if (gpio_isr_stop(pin) == MRAA_SUCCESS) {
            printf("Stopped monitoring level changes to pin %d\n", pin);
        } else {
            printf("Failed to deregister ISR for pin %d\n", pin);
        }
    } else {
        printf("Invalid command\n");
    }
}
```

## src/gpio-cmd.h
```c
#pragma once

void gpio_cmd_help(int argc, char* argv[]);
void gpio_cmd_list(int argc, char* argv[]);
void gpio_cmd_set(int argc, char* argv[]);
void gpio_cmd_get(int argc, char* argv[]);
void gpio_cmd_monitor(int argc, char* argv[]);
```

## src/i2c-cmd.c
```c
/*
 * Author: Henry Bruce <henry.bruce@intel.com>
 * Copyright (c) 2016 Intel Corporation.
 *
 * Permission is hereby granted, free of charge, to any person obtaining
 * a copy of this software and associated documentation files (the
 * "Software"), to deal in the Software without restriction, including
 * without limitation the rights to use, copy, modify, merge, publish,
 * distribute, sublicense, and/or sell copies of the Software, and to
 * permit persons to whom the Software is furnished to do so, subject to
 * the following conditions:
 *
 * The above copyright notice and this permission notice shall be
 * included in all copies or substantial portions of the Software.
 *
 * THE SOFTWARE IS PROVIDED "AS IS", WITHOUT WARRANTY OF ANY KIND,
 * EXPRESS OR IMPLIED, INCLUDING BUT NOT LIMITED TO THE WARRANTIES OF
 * MERCHANTABILITY, FITNESS FOR A PARTICULAR PURPOSE AND
 * NONINFRINGEMENT. IN NO EVENT SHALL THE AUTHORS OR COPYRIGHT HOLDERS BE
 * LIABLE FOR ANY CLAIM, DAMAGES OR OTHER LIABILITY, WHETHER IN AN ACTION
 * OF CONTRACT, TORT OR OTHERWISE, ARISING FROM, OUT OF OR IN CONNECTION
 * WITH THE SOFTWARE OR THE USE OR OTHER DEALINGS IN THE SOFTWARE.
 */

#include <stdio.h>
#include <stdlib.h>
#include <string.h>
#include "mraa/i2c.h"
#include "../source/mraa_internal.h"
#include "../source/mraa_internal_types.h"



void
print_help()
{
    printf("list                      List available busses\n");
    printf("detect bus                List detected devices on specified bus\n");
    printf("get bus device reg        Get value from specified device register\n");
    printf("set bus device reg value  Set specified device register to value\n");
}

void
print_command_error()
{
    printf("Invalid command, options are:\n");
    print_help();
}

void
print_busses()
{
    int i, bus;
    for (i = 0; i < plat->i2c_bus_count; ++i) {
        bus = i;
        char* busType = "internal";
        int id = plat->i2c_bus[i].bus_id;
        printf("Bus %3d: id=%02d type=%s ", bus, id, busType);
        if (i == plat->def_i2c_bus)
            printf(" default");
        if (id == -1)
            printf(" disabled");

        printf("\n");
    }
}

mraa_result_t
i2c_get(int bus, uint8_t device_address, uint8_t register_address, uint8_t* data)
{
    mraa_result_t status = MRAA_SUCCESS;
    mraa_i2c_context i2c = mraa_i2c_init(bus);
    if (i2c == NULL) {
        return MRAA_ERROR_NO_RESOURCES;
    }
    status = mraa_i2c_address(i2c, device_address);
    if (status != MRAA_SUCCESS) {
        goto i2c_get_exit;
    }
    int value = mraa_i2c_read_byte_data(i2c, register_address);
    if (value != -1) {
        *data = value & 0xFF;
        status = MRAA_SUCCESS;
    } else
        status = MRAA_ERROR_UNSPECIFIED;
i2c_get_exit:
    mraa_i2c_stop(i2c);
    return status;
}

mraa_result_t
i2c_set(int bus, uint8_t device_address, uint8_t register_address, uint8_t data)
{
    mraa_result_t status = MRAA_SUCCESS;
    mraa_i2c_context i2c = mraa_i2c_init(bus);
    if (i2c == NULL) {
        return MRAA_ERROR_NO_RESOURCES;
    }
    status = mraa_i2c_address(i2c, device_address);
    if (status != MRAA_SUCCESS) {
        printf("Could not set i2c device address\n");
        goto i2c_set_exit;
    }
    status = mraa_i2c_write_byte_data(i2c, data, register_address);
    if (status != MRAA_SUCCESS) {
        printf("Could not write to i2c register. Status = %d\n", status);
        goto i2c_set_exit;
    }
i2c_set_exit:
    mraa_i2c_stop(i2c);
    return status;
}

void
i2c_detect_devices(int bus)
{
    mraa_i2c_context i2c = mraa_i2c_init(bus);
    if (i2c == NULL) {
        return;
    }
    int addr;
    for (addr = 0x0; addr < 0x80; ++addr) {
        uint8_t value;
        if ((addr) % 16 == 0)
            printf("%02x: ", addr);
        if (i2c_get(bus, addr, 0, &value) == MRAA_SUCCESS)
            printf("%02x ", addr);
        else
            printf("-- ");
        if ((addr + 1) % 16 == 0)
            printf("\n");
    }
}

int
i2c_process_command(int argc, char** argv)
{
    int status = 0;
    if (strcmp(argv[1], "help") == 0) {
        print_help();
        return 0;
    } else if (strcmp(argv[1], "list") == 0) {
        print_busses();
        return 0;
    } else if (strcmp(argv[1], "detect") == 0) {
        if (argc == 3) {
            int bus = strtol(argv[2], NULL, 0);
            i2c_detect_devices(bus);
            return 0;
        } else {
            print_command_error();
            return 1;
        }
    } else if ((strcmp(argv[1], "get") == 0) || (strcmp(argv[1], "getrpt") == 0)) {
        if (argc == 5) {
            int interation = 0;
            mraa_boolean_t should_repeat = strcmp(argv[1], "getrpt") == 0;
            int bus = strtol(argv[2], NULL, 0);
            uint8_t device_address = strtol(argv[3], NULL, 0);
            uint8_t register_address = strtol(argv[4], NULL, 0);
            // printf("Device %02X, Register = %02X\n", device_address, register_address);
            uint8_t data;
            do {
                if (i2c_get(bus, device_address, register_address, &data) == MRAA_SUCCESS) {
                    if (should_repeat)
                        printf("%4d: ", interation);
                    printf("Register %#02X = %#02X\n", register_address, data);
                    status = 0;
                } else {
                    printf("i2c get failed\n");
                    status = 1;
                }
                interation++;
                // usleep(10000);
            } while (should_repeat && status == 0);
        } else {
            print_command_error();
            status = 1;
        }
        return status;
    } else if ((strcmp(argv[1], "set") == 0)) {
        if (argc == 6) {
            int bus = strtol(argv[2], NULL, 0);
            uint8_t device_address = strtol(argv[3], NULL, 0);
            uint8_t register_address = strtol(argv[4], NULL, 0);
            uint8_t value = strtol(argv[5], NULL, 0);
            printf("Device %02X, Register = %02X, Value = %02X\n", device_address,
                    register_address, value);
            if (i2c_set(bus, device_address, register_address, value) != MRAA_SUCCESS) {
                printf("i2c set failed\n");
                return 0;
            }
            return 1;
        } else {
            print_command_error();
            return 1;
        }
    } else {
        print_command_error();
        return 1;
    }
}
```

## src/i2c-cmd.h
```c
/*
 * Author: Henry Bruce <henry.bruce@intel.com>
 * Copyright (c) 2016 Intel Corporation.
 *
 * Permission is hereby granted, free of charge, to any person obtaining
 * a copy of this software and associated documentation files (the
 * "Software"), to deal in the Software without restriction, including
 * without limitation the rights to use, copy, modify, merge, publish,
 * distribute, sublicense, and/or sell copies of the Software, and to
 * permit persons to whom the Software is furnished to do so, subject to
 * the following conditions:
 *
 * The above copyright notice and this permission notice shall be
 * included in all copies or substantial portions of the Software.
 *
 * THE SOFTWARE IS PROVIDED "AS IS", WITHOUT WARRANTY OF ANY KIND,
 * EXPRESS OR IMPLIED, INCLUDING BUT NOT LIMITED TO THE WARRANTIES OF
 * MERCHANTABILITY, FITNESS FOR A PARTICULAR PURPOSE AND
 * NONINFRINGEMENT. IN NO EVENT SHALL THE AUTHORS OR COPYRIGHT HOLDERS BE
 * LIABLE FOR ANY CLAIM, DAMAGES OR OTHER LIABILITY, WHETHER IN AN ACTION
 * OF CONTRACT, TORT OR OTHERWISE, ARISING FROM, OUT OF OR IN CONNECTION
 * WITH THE SOFTWARE OR THE USE OR OTHER DEALINGS IN THE SOFTWARE.
 */

#pragma once

int i2c_process_command(int argc, char* argv[]);
void i2c_cmd_help(int argc, char* argv[]);
void i2c_cmd_list(int argc, char* argv[]);
void i2c_cmd_set(int argc, char* argv[]);
void i2c_cmd_get(int argc, char* argv[]);
void i2c_cmd_detect(int argc, char* argv[]);
```
