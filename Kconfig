## Kconfig
```kconfig
# Kconfig - Cryptography primitive options for TinyCrypt

#
# Copyright (c) 2015 Intel Corporation
#
# Licensed under the Apache License, Version 2.0 (the "License");
# you may not use this file except in compliance with the License.
# You may obtain a copy of the License at
#
#     http://www.apache.org/licenses/LICENSE-2.0
#
# Unless required by applicable law or agreed to in writing, software
# distributed under the License is distributed on an "AS IS" BASIS,
# WITHOUT WARRANTIES OR CONDITIONS OF ANY KIND, either express or implied.
# See the License for the specific language governing permissions and
# limitations under the License.
#

config  MRAA
        bool
        prompt "Mraa Support"
        default n
        select PINMUX
        select PINMUX_QMSI
        help
          This option enables the mraa lib

config  MRAA_GPIO
        bool
        prompt "Mraa GPIO function support"
        select MRAA
        select GPIO
        default n
        help
          This option enables support for MRAA GPIO

config  MRAA_AIO
        bool
        prompt "Mraa AIO function support"
        select MRAA
        select AIO
        default n
        help
          This option enables support for MRAA AIO

config  MRAA_I2C
        bool
        prompt "Mraa I2C function support"
        select I2C
        select MRAA
        select MRAA_GPIO
        default n
        help
          This option enables support for MRAA I2C

config  MRAA_PWM
        bool
        prompt "Mraa PWM function support"
        select PWM
        select MRAA
        default n
        help
          This option enables support for MRAA PWM

config  MRAA_UART
        bool
        prompt "Mraa UART function support"
        select UART
        select MRAA
        default n
        help
          This option enables support for MRAA UART

config  MRAA_SPI
        bool
        prompt "Mraa SPI function support"
        select SPI
        select GPIO
        select MRAA
        select PINMUX
        default n
        help
          This option enables support for MRAA SPI
```
